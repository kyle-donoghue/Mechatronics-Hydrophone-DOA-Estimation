#include "ChRt.h"
#include <ADC.h>
#include <ADC_util.h>

#define DATA_SIZE 256

SEMAPHORE_DECL(sem, 0);
SEMAPHORE_DECL(sem2, 0);

ADC *adc = new ADC();

//float firCoeff_float[] = {-0.000699098629411310,-0.000501460453961045,-0.000546094146557152,-0.000479126087157056,-0.000285442394670099,2.06028726097429e-05,0.000394317263271660,0.000767004676163197,0.00106110644992441,0.00120846147183329,0.00116997223813087,0.000948396918829531,0.000592541473452002,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-0.000501460453961045,-0.000699098629411310};
//int firNum = 219;
//float firCoeff_float[] = {0.00138702077562725,0.00281717989254814,0.00501441102681261,0.00751592883867004,0.00970875689691051,0.0107445340988839,0.00967066681031979,0.00567688211914375,-0.00159599114046373,-0.0118144596049033,-0.0237895509253148,-0.0355011682624448,-0.0443545508334457,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0.000273356121449945,0.000603230210817846};
//int firNum = 129;
float firCoeff_float[] = {0.00401976343561174,0.0121860231561700,0.0194297422681295,0.0136552769070512,-0.0145725376635977,-0.0577370409611251,-0.0863300157675888,-0.0650009188096079,0.0159569577732369,0.119560155887184,0.176894449807725,0.135643644230273,0.00662289476938902,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0.00128922058797579,-0.000129866597536070};
int firNum = 51;

float sampleData[] = {512,944,975,576,117,25,384,862,1014,700,211,1,265,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117,25};
float sampleSquareData[] = {1024,1024,1024,1024,0,0,0,1024,1024,1024,0,0,0,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0,0};
int sampleSize = 256; //512 amplitude 

float computationalDataStream[DATA_SIZE*2];
int computationalDataSize = DATA_SIZE*2;

float bufferDataStream[DATA_SIZE];
int bufferDataSize = DATA_SIZE;

float outputData_float[DATA_SIZE*2];

int dataCounter = 0;

static THD_WORKING_AREA(waAnalogProcessing, 64);
static THD_FUNCTION(AnalogProcessing,arg) {
  (void)arg;
  while (!chThdShouldTerminateX()) {
    chSemWait(&sem);
    unsigned long processingTime = micros();
    //Serial.println("buffer full");
    shiftDataStream(computationalDataStream,bufferDataStream,computationalDataSize); //move buffer
    convolve(firCoeff_float,firNum,computationalDataStream,outputData_float,computationalDataSize); //freq filter
    //convolve(firCoeff_float,firNum, sampleData,outputData_float,sampleSize); //freq filter
    
    //Serial.print("process time: ");
    //Serial.println(micros()-processingTime);
    chSemSignal(&sem2);
        //Serial.println("process complete");

  }
}

static THD_WORKING_AREA(waCommunication, 16);
static THD_FUNCTION(Communication,arg) {
  (void)arg;
  while (!chThdShouldTerminateX()) {
    chSemWait(&sem2);
    for(int i = 0; i < computationalDataSize;i++) {
      Serial.print(i);
      Serial.print(": ");
      Serial.println(outputData_float[i]);
    }
  }
}

static THD_WORKING_AREA(waAnalogReading, 64);
static THD_FUNCTION(AnalogReading, arg) {
  (void)arg;
  systime_t time = chVTGetSystemTime(); // Current system time.
  unsigned long bufferTime = micros();
  uint16_t dataCounter = 0;
  uint8_t cycleCounter = 0;
  uint16_t analogValue;
  while (TRUE) {
    time = chTimeAddX(time, TIME_US2I(16));
    for(uint8_t i = 0;i < 4;i++) {
    //analogValue = adc->analogReadContinuous(0); //uses library for quicker reads
    //bufferDataStream[dataCounter] = analogValue;
    //dataCounter++;
    analogValue = sampleData[dataCounter];
    bufferDataStream[dataCounter] = analogValue;
    dataCounter++;
    }
    

    if(dataCounter == bufferDataSize) {
      //Serial.print("buffer time: ");
      //Serial.println(micros()-bufferTime);
      chSemSignal(&sem);
      dataCounter = 0;
      //bufferTime = micros();

    }
    /*(if(cycleCounter == 255) {
      printSerial();
      chThdExit("ss");
    }*/
    //cycleCounter++;
    
    chThdSleepUntil(time);
  }
}
void chSetup() {
  chThdCreateStatic(waAnalogProcessing, sizeof(waAnalogProcessing), NORMALPRIO + 1, AnalogProcessing, NULL);

  chThdCreateStatic(waAnalogReading, sizeof(waAnalogReading), NORMALPRIO + 2, AnalogReading, NULL);
  
  chThdCreateStatic(waCommunication, sizeof(waCommunication), NORMALPRIO + 1, Communication, NULL);
}

void setup() {
  Serial.begin(6000000);
  adc->adc0->setAveraging(0);
  adc->adc0->setConversionSpeed(ADC_CONVERSION_SPEED::HIGH_SPEED);
  adc->adc0->setSamplingSpeed(ADC_SAMPLING_SPEED::HIGH_SPEED);
  adc->startContinuous(0);
   
  chBegin(chSetup);
  while (true) {}
}

void loop() {
}


void shiftDataStream(float *dS, float *bS, int n) { //computational data stream is in two parts, old and new, to prevent transient error. This fn shifts the new section into the old section and moves the buffer into the new section

  for(int i = n/2; i < n;i++) {
    dS[i-n/2] = dS[i]; //shift data
    dS[i] = bS[i-n/2]; //move buffer to computational
    bS[i-n/2] = 0; //clear buffer
  }
}

void convolve (float *p_coeffs, int p_coeffs_n,
               float *p_in, float *p_out, int n)
{
  int i, j, k;
  float tmp;

  for (k = 0; k < n; k++)  //  position in output
  {
    tmp = 0;

    for (i = 0; i < p_coeffs_n; i++)  //  position in coefficients array
    {
      j = k - i;  //  position in input

      if (j >= 0)  //  bounds check for input buffer
      {
        tmp += p_coeffs [i] * p_in [j];
      }
    }

    p_out [k] = tmp;
  }
}
